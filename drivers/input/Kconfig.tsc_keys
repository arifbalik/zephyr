## drivers/input/Kconfig.tsc_keys
```kconfig
# Copyright (c) 2024 Arif Balik <arifbalik@outlook.com>
# SPDX-License-Identifier: Apache-2.0

config INPUT_STM32_TSC_KEYS
	bool "STM32 touch keys (TSC)"
	default y
	depends on DT_HAS_ST_STM32_TSC_ENABLED
	help
	  Touch keys on the STM32 Touch Sensing Controller (TSC).

config INPUT_STM32_TSC_KEYS_BUFFER_WORD_SIZE
	int "Samples kept per touch key"
	default 10
	range 1 256
	depends on INPUT_STM32_TSC_KEYS
	help
	  Number of samples the driver keeps for each key. A key is pressed
	  when the newest sample is lower than the oldest one by more than
	  the noise-threshold of the key.

	  The samples span this value times sampling-interval-ms, 100 ms
	  with the defaults. A touch has to arrive within that time.
```

## dts/bindings/input/st,stm32-tsc.yaml
```yaml
# Copyright (c) 2024 Arif Balik <arifbalik@outlook.com>
# SPDX-License-Identifier: Apache-2.0

description: STM32 Touch Sensing Controller (TSC) driver

compatible: "st,stm32-tsc"

include: [base.yaml, pinctrl-device.yaml, reset-device.yaml]

properties:
  reg:
    required: true
  clocks:
    required: true
  resets:
    required: true
  interrupts:
    required: true
  pinctrl-0:
    required: true
  pinctrl-names:
    required: true

  st,pulse-generator-prescaler:
    type: int
    required: true
    description: |
      Prescaler for the pulse generator clock (t_pgclk=f_hclk/prescaler).
      The prescaler is used to generate the charge transfer pulse. The value
      of this property is the division factor itself.
    enum: [1, 2, 4, 8, 16, 32, 64, 128]

  st,charge-transfer-pulse-high:
    type: int
    required: true
    description: |
      Number of cycles for the high state of the
      charge transfer pulse (1 to 16 cycles of t_pgclk).
    min: 1
    max: 16

  st,charge-transfer-pulse-low:
    type: int
    required: true
    description: |
      Number of cycles for the low state of the
      charge transfer pulse (1 to 16 cycles of t_pgclk).
    min: 1
    max: 16

  st,spread-spectrum:
    type: boolean
    description: Spread spectrum enable

  st,spread-spectrum-prescaler:
    type: int
    required: true
    description: Spread spectrum clock prescaler (t_ssclk)
    enum:
      - 1
      - 2

  st,spread-spectrum-deviation:
    type: int
    required: true
    description: Spread spectrum deviation (1 to 128 cycles of t_ssclk)
    min: 1
    max: 128

  st,max-count-value:
    type: int
    required: true
    description: |
      Max number of charge transfer pulses before max count error is generated.
      The value of this property is the maximum counter value itself.
    enum: [255, 511, 1023, 2047, 4095, 8191, 16383, 32767]

  st,synced-acquisition:
    type: boolean
    description: |
      Synchronized acquisition enable.
      Acquisition starts when START bit and signal on sync pin.
      You have to provide a pinctrl for the sync pin.

  st,syncpol-rising:
    type: boolean
    description: Rising synchronization pin polarity, instead of falling

  st,iodef-float:
    type: boolean
    description: |
      Set default state (not acquisition) of all channel I/Os to floating.
      push-pull down by default.

child-binding:
  description: STM32 TSC group configuration
  properties:
    group:
      type: int
      required: true
      description: |
        Group number, starting from 1. The number of groups depends on the
        SoC (up to 8).
      min: 1
      max: 8

    channel-ios:
      type: int
      required: true
      description: |
        Channel I/Os to be enabled, as a bit mask of TSC_IOx values
        (see dt-bindings/input/stm32-tsc-defines.h).
      min: 1
      max: 15

    sampling-io:
      type: int
      required: true
      description: Channel to be selected for sampling
      enum:
        - 1
        - 2
        - 4
        - 8

    st,use-as-shield:
      type: boolean
      description: |
        Use channel as shield. This configures group but
        does not enable it for acquisition. channel-io is used
        as shield pin and can only have values 1, 2, 4 or 8.
```

## dts/bindings/input/tsc-keys.yaml
```yaml
# Copyright (c) 2024 Arif Balik <arifbalik@outlook.com>
# SPDX-License-Identifier: Apache-2.0

description: |
  Input driver for STM32 Touch Sensing Controller (TSC).

  This node is a st,stm32-tsc grandchild node and applies filters and
  calculations to detect an input event on a group which is the child of
  st,stm32-tsc. For more information see dts/bindings/input/st,stm32-tsc.yaml

compatible: "tsc-keys"

include:
  - name: base.yaml
    property-allowlist:
      - compatible
      - zephyr,deferred-init
      - label
      - status

properties:
  sampling-interval-ms:
    type: int
    required: true
    description: |
      Sampling interval in milliseconds.
  oversampling:
    type: int
    deprecated: true
    description: |
      Unused. The time window over which a press or release is detected is
      CONFIG_INPUT_STM32_TSC_KEYS_BUFFER_WORD_SIZE samples taken every
      sampling-interval-ms milliseconds.
  noise-threshold:
    type: int
    required: true
    description: |
      This value will be used to reject the noise for both
      directions of the slope.
  sticky-key-timeout-ms:
    type: int
    required: true
    description: |
      Time in milliseconds after a reported press within which a release
      must be detected. If none is detected by then, a release event is
      generated and the key returns to the released state.
  zephyr,code:
    type: int
    required: true
    description: Key code to emit.

examples:
  - |
    #include <zephyr/dt-bindings/input/input-event-codes.h>

    &tsc {
      compatible = "st,stm32-tsc";

      tsc_group6: g6 {
        /* ... */
        ts1 {
          compatible = "tsc-keys";
          sampling-interval-ms = <10>;
          noise-threshold = <50>;
          sticky-key-timeout-ms = <10000>;
          zephyr,code = <INPUT_KEY_0>;
        };
      };
    };
```

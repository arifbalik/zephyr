## boards/st/stm32mp135f_dk/Kconfig.defconfig
```kconfig
# STM32MP135F discovery board configuration

# Copyright (c) 2024 STMicroelectronics
# SPDX-License-Identifier: Apache-2.0

if BOARD_STM32MP135F_DK

config CLOCK_STM32_HSE_CLOCK
	default 64000000

endif # BOARD_STM32MP135F_DK
```

## boards/st/stm32mp135f_dk/Kconfig.stm32mp135f_dk
```kconfig
# Copyright (c) 2019 STMicroelectronics
# SPDX-License-Identifier: Apache-2.0

config BOARD_STM32MP135F_DK
	select SOC_STM32MP13_A7
```

## boards/st/stm32mp135f_dk/stm32mp135f_dk_defconfig
```kconfig
# enable GPIO
CONFIG_GPIO=y

# Enable MPU
CONFIG_ARM_MPU=n

# Enable HW stack protection
CONFIG_HW_STACK_PROTECTION=n

CONFIG_CLOCK_CONTROL=y

# enable uart driver
CONFIG_SERIAL=y
CONFIG_UART_INTERRUPT_DRIVEN=y

# console (remote proc console by default)
CONFIG_CONSOLE=y
CONFIG_RAM_CONSOLE=n
CONFIG_RAM_CONSOLE_BUFFER_SIZE=1024

# uart console (overrides remote proc console)
CONFIG_UART_CONSOLE=y

CONFIG_ARM_ARCH_TIMER=y
CONFIG_SYS_CLOCK_EXISTS=y
CONFIG_SYS_CLOCK_TICKS_PER_SEC=64000000
CONFIG_ARM_MMU_NUM_L2_TABLES=256
```

## drivers/misc/stm32_tsc/Kconfig
```kconfig
# Copyright (c) 2024 Arif Balik <arifbalik@outlook.com>
# SPDX-License-Identifier: Apache-2.0

config STM32_TSC
	bool "STM32 TSC driver"
	depends on DT_HAS_ST_STM32_TSC_ENABLED
	help
	  Enable driver for STM32 TSC peripheral.

if STM32_TSC

config STM32_TSC_INTERRUPT
	bool "Use interrupt for STM32 TSC"
	default y
	help
	  Use interrupt for STM32 TSC peripheral.

endif
```

## dts/bindings/interrupt-controller/st,stm32mp13-intc.yaml
```yaml
description: |
        STM32 controller
        This compatible stands for the stm32H7RS interrupt-controller block
        with two dedicated Rising and Falling interrupt pending registers
        
compatible: "arm_gic_v2"
```

## soc/st/stm32/stm32mp13x/Kconfig
```kconfig
# STMicroelectronics STM32MP1 MPU series

# Copyright (c) 2019 STMicroelectronics
# SPDX-License-Identifier: Apache-2.0

config SOC_SERIES_STM32MP13X
	select ARM
	select CPU_CORTEX_A7
	select HAS_STM32CUBE
	select CPU_HAS_ARM_MPU
	select CPU_HAS_FPU
```

## soc/st/stm32/stm32mp13x/Kconfig.defconfig
```kconfig
# STMicroelectronics STM32MP13 MCU/MPU line

# Copyright (c) 2024 STMicroelectronics
# SPDX-License-Identifier: Apache-2.0

if SOC_SERIES_STM32MP13X

rsource "Kconfig.defconfig.stm32mp13_a7"

endif # SOC_SERIES_STM32MP13X
```

## soc/st/stm32/stm32mp13x/Kconfig.defconfig.stm32mp13_a7
```kconfig
# STMicroelectronics STM32MP157C_M4 MCU

# Copyright (c) 2024 STMicroelectronics
# SPDX-License-Identifier: Apache-2.0

if SOC_STM32MP13_A7

config NUM_IRQS
	default 150

endif # SOC_STM32MP13_A7
```
